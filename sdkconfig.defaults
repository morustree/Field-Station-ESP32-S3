## sdkconfig.defaults
```kconfig
# Target Chip
CONFIG_IDF_TARGET="esp32s3"

# Flash Settings (8MB)
CONFIG_ESPTOOLPY_FLASHSIZE_8MB=y
CONFIG_ESPTOOLPY_FLASHMODE_DIO=y
CONFIG_ESPTOOLPY_FLASHFREQ_80M=y

# Custom Partition Table
CONFIG_PARTITION_TABLE_CUSTOM=y
CONFIG_PARTITION_TABLE_CUSTOM_FILENAME="partitions.csv"
CONFIG_PARTITION_TABLE_FILENAME="partitions.csv"

# PSRAM (SPIRAM) Configuration for ESP32-S3 N8R2
CONFIG_SPIRAM=y
CONFIG_SPIRAM_MODE_QUAD=y
CONFIG_SPIRAM_TYPE_AUTO=y
CONFIG_SPIRAM_CLK_IO=30
CONFIG_SPIRAM_CS_IO=26
CONFIG_SPIRAM_SPEED_40M=y
CONFIG_SPIRAM_BOOT_INIT=y
CONFIG_SPIRAM_USE_MALLOC=y
CONFIG_SPIRAM_MEMTEST=y

# CPU Frequency
CONFIG_ESP_DEFAULT_CPU_FREQ_MHZ_160=y

# Logging Level (NONE for absolute silence)
CONFIG_LOG_DEFAULT_LEVEL_NONE=y
CONFIG_LOG_DEFAULT_LEVEL=0

# LittleFS Component Settings
CONFIG_LITTLEFS_OBJ_NAME_LEN=64

# FreeRTOS Settings
CONFIG_FREERTOS_HZ=100
```
